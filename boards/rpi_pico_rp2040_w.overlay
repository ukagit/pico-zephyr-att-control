/* Pico W 2022 / RP2040, 2 MiB flash. Console via cdc-acm-console snippet. */
&flash0 {
    partitions {
        compatible = "fixed-partitions";
        #address-cells = <1>;
        #size-cells = <1>;
        storage_partition: partition@1f0000 {
            label = "storage";
            reg = <0x001f0000 0x00010000>;
        };
    };
};
&uart0 { status = "disabled"; };
