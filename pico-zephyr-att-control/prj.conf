## CMakeLists.txt
```
cmake_minimum_required(VERSION 3.20.0)
find_package(Zephyr REQUIRED HINTS $ENV{ZEPHYR_BASE})
project(pico_zephyr_att_control)
target_sources(app PRIVATE src/main.c src/attenuator.c src/att_codec.c src/http.c src/network/network.c src/network/tcp_console.c)
```

## prj.conf
```kconfig
CONFIG_GPIO=y
CONFIG_NETWORKING=y
CONFIG_NET_IPV4=y
CONFIG_NET_DHCPV4=y
CONFIG_NET_TCP=y
CONFIG_NET_SOCKETS=y
CONFIG_WIFI=y
CONFIG_NET_MGMT=y
CONFIG_NET_MGMT_EVENT=y
CONFIG_NET_SHELL=y
CONFIG_SHELL=y
CONFIG_SHELL_BACKEND_SERIAL=y
CONFIG_SHELL_BACKEND_TELNET=n
CONFIG_SHELL_BACKEND_DUMMY=y
CONFIG_SHELL_BACKEND_DUMMY_BUF_SIZE=8192
CONFIG_MAIN_STACK_SIZE=4096
CONFIG_SYSTEM_WORKQUEUE_STACK_SIZE=2048
CONFIG_HEAP_MEM_POOL_SIZE=8192
CONFIG_LOG=y
CONFIG_PICOLIBC_IO_FLOAT=y
CONFIG_UDC_DRIVER_LOG_LEVEL_OFF=y
CONFIG_SHELL_STACK_SIZE=5200
CONFIG_NET_TX_STACK_SIZE=2048
CONFIG_NET_RX_STACK_SIZE=2048
CONFIG_NET_PKT_RX_COUNT=16
CONFIG_NET_PKT_TX_COUNT=32
CONFIG_NET_BUF_RX_COUNT=32
CONFIG_NET_BUF_TX_COUNT=64
CONFIG_NET_MAX_CONTEXTS=16
CONFIG_NET_MAX_CONN=16
CONFIG_WIFI_USAGE_MODE_STA_AP=y
CONFIG_NET_L2_WIFI_MGMT=y
CONFIG_NET_L2_WIFI_SHELL=y
CONFIG_NET_CONNECTION_MANAGER=y
CONFIG_NET_MGMT_EVENT_STACK_SIZE=1536
CONFIG_NET_MGMT_EVENT_QUEUE_TIMEOUT=5000
CONFIG_NET_MGMT_EVENT_QUEUE_SIZE=16
CONFIG_WIFI_CREDENTIALS=y
CONFIG_WIFI_CREDENTIALS_BACKEND_SETTINGS=y
CONFIG_SETTINGS=y
CONFIG_FLASH=y
CONFIG_FLASH_MAP=y
CONFIG_NVS=y
CONFIG_SETTINGS_NVS=y
CONFIG_USBD_CDC_ACM_BUF_POOL=y
CONFIG_USBD_CDC_ACM_BUF_POOL_SIZE=4096

# RP2040 bring-up: timer-based RNG for Zephyr networking (not cryptographic).
CONFIG_TEST_RANDOM_GENERATOR=y
CONFIG_TIMER_RANDOM_GENERATOR=y

# Network dependencies.
CONFIG_NET_UDP=y
CONFIG_DNS_RESOLVER=y
CONFIG_NET_DHCPV4_OPTION_DNS_ADDRESS=y




# AP test: native DHCP server, two clients; mode remains RAM-only.
CONFIG_NET_DHCPV4_SERVER=y
CONFIG_NET_DHCPV4_SERVER_ADDR_COUNT=2
CONFIG_NET_MGMT_EVENT_INFO=y

# Reserve the log shell command for HamLab typed data streams.
CONFIG_LOG_CMDS=n
```

## src/main.c
```c
#include <zephyr/kernel.h>
#include <zephyr/version.h>
#include <zephyr/device.h>
#include <zephyr/drivers/gpio.h>
#include <zephyr/settings/settings.h>
#include <zephyr/shell/shell.h>
#include <string.h>
#include <errno.h>
#include "hamlab_version.h"
#include "attenuator.h"
#include "att_codec.h"
#include "network/network.h"
static int cmd_att(const struct shell *sh, size_t argc, char **argv)
{
    int rc = 0;
    if (argc == 3 && !strcmp(argv[1], "set")) {
        unsigned db;
        rc = att_parse_db(argv[2], &db);
        if (!rc) rc = att_set(db);
    } else if (argc != 2 || strcmp(argv[1], "status")) {
        shell_error(sh, "att status | att set <0..127>");
        return -EINVAL;
    }
    if (rc) { shell_error(sh, "att error: %d", rc); return rc; }
    char json[256];
    rc = att_json(json, sizeof(json));
    if (rc < 0) return rc;
    shell_print(sh, "%s", json);
    return 0;
}
static int cmd_info(const struct shell *sh, size_t argc, char **argv)
{
    ARG_UNUSED(argc); ARG_UNUSED(argv);
    shell_print(sh, "name: pico-zephyr-att-control\nfirmware: " HAMLAB_VERSION
        "\nzephyr: " KERNEL_VERSION_STRING "\nboard: " CONFIG_BOARD
        "\nuptime_s: %lld", (long long)(k_uptime_get()/1000));
    char *status[] = {"att", "status"};
    return cmd_att(sh, 2, status);
}
SHELL_CMD_ARG_REGISTER(att, NULL, "status | set <dB>", cmd_att, 2, 1);
SHELL_CMD_REGISTER(info, NULL, "Firmware and attenuator status", cmd_info);
int main(void)
{
    int rc = att_init();
    printk("pico-zephyr-att-control " HAMLAB_VERSION " GPIO init: %d\n", rc);
    /* Do not delay output initialization while connecting WLAN. */
    int settings_rc = settings_subsys_init();
    if (!settings_rc) settings_rc = settings_load();
    printk("Settings: %d\n", settings_rc);
    /* GP21 is a 32 dB output: never configure it as a boot button.
     * Always start STA; AP remains available via USB: wifi_mode ap. */
    printk("Network boot: %d\n", hamlab_network_boot(false));
    return 0;
}
```

## src/att_web.h
```c
/* Generated by tools/embed_web.py; edit web/att.html. */
static const char page[] =
"<!doctype html>\n"
"<html lang=\"de\"><head><meta charset=\"utf-8\"><meta name=\"viewport\" content=\"width=device-width,initial-scale=1\">\n"
"<title>HamLab Attenuator</title>\n"
"<style>\n"
"body{background:#101820;color:#edf4f8;font:17px system-ui;max-width:920px;margin:auto;padding:20px}\n"
"header,article{background:#203040;border-radius:14px;padding:20px;margin:15px 0}\n"
"h1{margin:0 0 8px;font-size:28px}h2{margin:0 0 12px;font-size:20px}.grid{display:grid;grid-template-columns:repeat(auto-fit,minmax(250px,1fr));gap:16px}\n"
".value{font-size:64px;color:#77e1bc;font-variant-numeric:tabular-nums}.value small{font-size:28px;color:#77e1bc}small,.note{color:#bfcedb}\n"
"button,input{font:inherit}button{background:#31495d;color:#edf4f8;border:1px solid #708596;border-radius:7px;padding:10px;cursor:pointer}button:hover{border-color:#77e1bc}\n"
"input[type=number]{background:#101820;color:#edf4f8;border:1px solid #708596;border-radius:7px;padding:10px;width:100px}input:focus,button:focus-visible{outline:2px solid #77e1bc;outline-offset:3px}\n"
".controls{display:flex;flex-wrap:wrap;align-items:center;gap:10px;margin-top:18px}input[type=range]{width:100%;accent-color:#77e1bc;margin-top:20px}\n"
".meter{height:32px;background:#101820;border:1px solid #708596;border-radius:7px;overflow:hidden}.fill{height:100%;width:0;background:#77e1bc;transition:width .1s}.ticks{display:flex;justify-content:space-between;font-size:14px;color:#bfcedb;margin-top:6px}\n"
"table{width:100%;text-align:left;border-collapse:collapse}td,th{padding:7px 4px;border-bottom:1px solid #31495d}.on{color:#77e1bc}.bad{color:#ffb17b}pre{white-space:pre-wrap;overflow-wrap:anywhere;font-size:13px}.note{font-size:14px;line-height:1.5}#status{min-height:1.5em}footer{font-size:13px;color:#bfcedb;padding:5px 0 20px}\n"
"@media(max-width:480px){body{padding:10px}header,article{padding:16px}.value{font-size:54px}}\n"
"</style></head><body>\n"
"<header><h1>HamLab Attenuator</h1><small>Weinschel 3200 · Pico W · Firmware "
HAMLAB_VERSION
"</small><div id=\"status\" role=\"status\" aria-live=\"polite\">Verbinde …</div></header>\n"
"<div class=\"grid\"><article><h2>Dämpfung</h2><div class=\"value\"><span id=\"actual\">--</span> <small>dB</small></div>\n"
"<div class=\"meter\" role=\"meter\" aria-label=\"Gesetzte Dämpfung\" aria-valuemin=\"0\" aria-valuemax=\"127\" id=\"meter\"><div class=\"fill\" id=\"fill\"></div></div>\n"
"<div class=\"ticks\"><span>0</span><span>32</span><span>64</span><span>96</span><span>127 dB</span></div>\n"
"<div class=\"controls\"><label for=\"db\">Sollwert</label><input id=\"db\" type=\"number\" min=\"0\" max=\"127\" step=\"1\" value=\"0\" required><span>dB</span><button id=\"set\">Setzen</button></div>\n"
"<input id=\"slider\" type=\"range\" min=\"0\" max=\"127\" step=\"1\" value=\"0\" aria-label=\"Dämpfung einstellen\">\n"
"<div class=\"controls\"><button id=\"minus\" aria-label=\"Ein dB weniger\">−1 dB</button><button id=\"plus\" aria-label=\"Ein dB mehr\">+1 dB</button><button id=\"read\">Status</button></div>\n"
"<p class=\"note\">Mausrad über dem Zahlenfeld: 1 dB pro Schritt. Nach kurzer Pause wird der Wert automatisch gesetzt. Schieberegler und ±1-dB-Tasten setzen ebenfalls direkt.</p>\n"
"</article><article><h2>Schaltstellung</h2><table><thead><tr><th>GPIO</th><th>Zelle</th><th>Zustand</th></tr></thead><tbody id=\"cells\"></tbody></table>\n"
"<p class=\"note\">Anzeige der zuletzt gesetzten Stellung, keine HF-Rückmessung. Einschaltwert: 0 dB.</p>\n"
"<details><summary>API-Status</summary><pre id=\"raw\">--</pre></details></article></div>\n"
"<footer>HamLab · DL2DBG · 0–127 dB in 1-dB-Schritten</footer>\n"
"<script>\n"
"'use strict';\n"
"const el=id=>document.getElementById(id);\n"
"const pins=[19,20,22,26,27,18,21,28], weights=[1,2,4,8,16,32,32,32];\n"
"let pending=null,busy=false,timer=null,editVersion=0;\n"
"function status(text,bad=false){el('status').textContent=text;el('status').className=bad?'bad':'';}\n"
"function value(){const n=Number(el('db').value);return el('db').value!==''&&Number.isInteger(n)&&n>=0&&n<=127?n:null;}\n"
"function target(n){n=Math.max(0,Math.min(127,n));el('db').value=String(n);el('slider').value=String(n);return n;}\n"
"function render(s,sync){\n"
" if(!Number.isInteger(s.attenuation_db)||!Number.isInteger(s.mask))throw Error('Ungültiger API-Status');\n"
" el('actual').textContent=s.attenuation_db;el('fill').style.width=(s.attenuation_db/127*100)+'%';\n"
" el('meter').setAttribute('aria-valuenow',s.attenuation_db);el('raw').textContent=JSON.stringify(s,null,2);\n"
" el('cells').innerHTML=pins.map((p,i)=>'<tr><td>GP'+p+'</td><td>'+weights[i]+' dB</td><td class=\"'+((s.mask&(1<<i))?'on':'')+'\">'+((s.mask&(1<<i))?'Ein':'Aus')+'</td></tr>').join('');\n"
" if(sync)target(s.attenuation_db);\n"
" status(s.ready?'Bereit · '+s.attenuation_db+' dB':'GPIO-Fehler: '+s.gpio_error,!s.ready);\n"
"}\n"
"async function api(path,method){const abort=new AbortController();const timeout=setTimeout(()=>abort.abort(),5000);\n"
" try{const r=await fetch(path,{method,signal:abort.signal,cache:'no-store'});const s=await r.json();\n"
" if(!r.ok)throw Error(s.error||('HTTP '+r.status));return s;}finally{clearTimeout(timeout);}}\n"
"async function flush(){\n"
" if(busy||pending===null)return;\n"
" const n=pending, version=editVersion;pending=null;busy=true;status('Setze '+n+' dB …');\n"
" try{render(await api('/api/v1/att/'+n,'POST'),version===editVersion);}\n"
" catch(e){pending=null;status('Setzen fehlgeschlagen: '+e.message+' · Status prüfen und erneut setzen',true);}\n"
" finally{busy=false;if(pending!==null){clearTimeout(timer);timer=setTimeout(flush,200);}}\n"
"}\n"
"function queue(immediate=false){const n=value();if(n===null){status('Bitte eine ganze Zahl von 0 bis 127 eingeben.',true);return;}\n"
" editVersion++;pending=n;el('slider').value=String(n);status('Sollwert '+n+' dB · wartet …');clearTimeout(timer);timer=setTimeout(flush,immediate?0:200);}\n"
"function step(delta){target((value()??0)+delta);queue();}\n"
"el('db').addEventListener('wheel',e=>{e.preventDefault();if(e.deltaY!==0)step(e.deltaY<0?1:-1);},{passive:false});\n"
"el('db').addEventListener('input',()=>{editVersion++;pending=null;clearTimeout(timer);if(value()!==null)el('slider').value=String(value());});\n"
"el('db').addEventListener('keydown',e=>{if(e.key==='Enter'){e.preventDefault();queue(true);}});\n"
"el('set').onclick=()=>queue(true);\n"
"el('minus').onclick=()=>step(-1);el('plus').onclick=()=>step(1);\n"
"el('slider').addEventListener('input',()=>{target(Number(el('slider').value));queue();});\n"
"async function read(){if(busy||pending!==null){status('Schaltvorgang läuft …');return;}busy=true;const version=editVersion;\n"
" try{render(await api('/api/v1/state','GET'),version===editVersion);}catch(e){status('Status nicht erreichbar: '+e.message,true);}\n"
" finally{busy=false;if(pending!==null){clearTimeout(timer);timer=setTimeout(flush,200);}}}\n"
"el('read').onclick=read;read();\n"
"</script></body></html>\n";
```

## src/attenuator.c
```c
#include "attenuator.h"
#include "att_config.h"
#include "att_codec.h"
#include <zephyr/kernel.h>
#include <zephyr/device.h>
#include <zephyr/drivers/gpio.h>
#include <stdio.h>
#include <errno.h>
static const struct device *gpio = DEVICE_DT_GET(DT_NODELABEL(gpio0));
static const unsigned pins[ATT_CELL_COUNT] = ATT_GPIO_PINS;
K_MUTEX_DEFINE(att_lock);
static unsigned current_db;
static uint8_t current_mask;
static int io_error = -EAGAIN;
static int64_t last_change;
int att_init(void)
{
    k_mutex_lock(&att_lock, K_FOREVER);
    int rc = device_is_ready(gpio) ? 0 : -ENODEV;
    for (unsigned i = 0; !rc && i < ATT_CELL_COUNT; ++i)
        rc = gpio_pin_configure(gpio, pins[i],
            (ATT_ACTIVE_LOW_MASK & (1u << i)) ? GPIO_OUTPUT_HIGH : GPIO_OUTPUT_LOW);
    io_error = rc;
    last_change = k_uptime_get();
    k_mutex_unlock(&att_lock);
    return rc;
}
int att_set(unsigned db)
{
    uint8_t mask;
    int rc = att_encode(db, &mask);
    if (rc) return rc;
    k_mutex_lock(&att_lock, K_FOREVER);
    if (io_error) { rc = io_error; goto done; }
    if (mask == current_mask) goto done;
    int64_t wait = ATT_CHANGE_INTERVAL_MS - (k_uptime_get() - last_change);
    if (wait > 0) k_msleep((int32_t)wait);
    gpio_port_pins_t select = 0, values = 0;
    for (unsigned i = 0; i < ATT_CELL_COUNT; ++i) {
        select |= BIT(pins[i]);
        if ((mask ^ ATT_ACTIVE_LOW_MASK) & (1u << i)) values |= BIT(pins[i]);
    }
    /* One masked port write: avoids sequential software bit transitions.
     * Mechanical relays still have different operate/release times. */
    rc = gpio_port_set_masked_raw(gpio, select, values);
    last_change = k_uptime_get();
    if (rc) { io_error = rc; goto done; }
    k_msleep(ATT_SETTLE_MS);
    current_db = db;
    current_mask = mask;
done:
    k_mutex_unlock(&att_lock);
    return rc;
}
int att_json(char *out, size_t size)
{
    k_mutex_lock(&att_lock, K_FOREVER);
    int n = snprintf(out, size,
        "{\"attenuation_db\":%u,\"mask\":%u,\"max_db\":%u,"
        "\"ready\":%s,\"gpio_error\":%d,\"feedback\":false}",
        current_db, current_mask, ATT_MAX_DB, io_error ? "false" : "true", io_error);
    k_mutex_unlock(&att_lock);
    return n < 0 || (size_t)n >= size ? -ENOSPC : n;
}
```

## src/attenuator.h
```c
#pragma once
#include <stddef.h>
int att_init(void);
int att_set(unsigned db);
int att_json(char *out, size_t size);
```

## src/hamlab_version.h
```c
#pragma once
#define HAMLAB_VERSION "0.1.2"
```

## src/http.c
```c
#include <zephyr/kernel.h>
#include <zephyr/net/socket.h>
#include <stdio.h>
#include <string.h>
#include <errno.h>
#include "attenuator.h"
#include "att_codec.h"
#include "hamlab_version.h"
#include "att_web.h"
static int send_all(int fd, const char *s, size_t n)
{
    while (n) {
        ssize_t sent = zsock_send(fd, s, n, 0);
        if (sent <= 0) return -EIO;
        s += sent; n -= (size_t)sent;
    }
    return 0;
}
static void reply(int fd, int code, const char *type, const char *body)
{
    char h[256];
    const char *reason = code == 200 ? "OK" : code == 404 ? "Not Found" :
        code == 503 ? "Service Unavailable" : "Bad Request";
    int n = snprintf(h, sizeof(h), "HTTP/1.1 %d %s\r\nContent-Type: %s; charset=utf-8\r\n"
        "Content-Length: %zu\r\nConnection: close\r\nCache-Control: no-store\r\n\r\n",
        code, reason, type, strlen(body));
    if (n > 0 && (size_t)n < sizeof(h) && !send_all(fd,h,(size_t)n))
        (void)send_all(fd, body, strlen(body));
}
static void serve(int fd)
{
    struct timeval timeout = {.tv_sec = 3};
    zsock_setsockopt(fd, SOL_SOCKET, SO_RCVTIMEO, &timeout, sizeof(timeout));
    zsock_setsockopt(fd, SOL_SOCKET, SO_SNDTIMEO, &timeout, sizeof(timeout));
    char request[1024], method[8], path[128], version[16], extra;
    size_t used = 0;
    int64_t deadline = k_uptime_get() + 3000;
    for (;;) {
        if (used == sizeof(request)-1 || k_uptime_get() >= deadline) {
            reply(fd,400,"application/json","{\"error\":\"headers too large or slow\"}"); return;
        }
        ssize_t n = zsock_recv(fd, request+used, sizeof(request)-used-1, 0);
        if (n <= 0) return;
        used += (size_t)n; request[used] = 0;
        if (strstr(request, "\r\n\r\n")) break;
    }
    char *eol = strstr(request, "\r\n");
    if (!eol) return;
    *eol = 0;
    if (sscanf(request,"%7s %127s %15s %c",method,path,version,&extra) != 3 ||
        (strcmp(version,"HTTP/1.1") && strcmp(version,"HTTP/1.0"))) {
        reply(fd,400,"application/json","{\"error\":\"invalid request\"}"); return;
    }
    if (!strcmp(method,"GET") && !strcmp(path,"/")) {
        reply(fd,200,"text/html",page); return;
    }
    int rc = 0;
    if (!strcmp(method,"POST") && !strncmp(path,"/api/v1/att/",12)) {
        unsigned db;
        rc = att_parse_db(path+12, &db);
        if (rc) { reply(fd,400,"application/json","{\"error\":\"expected integer 0..127\"}"); return; }
        rc = att_set(db);
    } else if (strcmp(method,"GET") || (strcmp(path,"/api/v1/state") && strcmp(path,"/api/v1/att"))) {
        reply(fd,404,"application/json","{\"error\":\"unknown route\"}"); return;
    }
    char json[256];
    int n = att_json(json, sizeof(json));
    if (n < 0) { reply(fd,503,"application/json","{\"error\":\"status unavailable\"}"); return; }
    reply(fd,rc ? 503 : 200,"application/json",json);
}
static void http_thread(void *a, void *b, void *c)
{
    ARG_UNUSED(a); ARG_UNUSED(b); ARG_UNUSED(c);
    for (;;) {
        int fd = zsock_socket(AF_INET, SOCK_STREAM, IPPROTO_TCP);
        if (fd < 0) { k_sleep(K_SECONDS(2)); continue; }
        int reuse = 1;
        zsock_setsockopt(fd,SOL_SOCKET,SO_REUSEADDR,&reuse,sizeof(reuse));
        struct sockaddr_in addr = {.sin_family=AF_INET,.sin_port=htons(8080),.sin_addr={.s_addr=INADDR_ANY}};
        if (zsock_bind(fd,(struct sockaddr *)&addr,sizeof(addr)) || zsock_listen(fd,2)) {
            zsock_close(fd); k_sleep(K_SECONDS(2)); continue;
        }
        for (;;) {
            int client = zsock_accept(fd,NULL,NULL);
            if (client < 0) break;
            serve(client); zsock_close(client);
        }
        zsock_close(fd);
    }
}
K_THREAD_DEFINE(att_http_id,4096,http_thread,NULL,NULL,NULL,10,0,0);
```
